/* This file is generated by nds_ldsag (version (2015-04-02) ). */
ENTRY(_start)
SECTIONS
{
	PROVIDE (__executable_start = 0x00000000);
	NDS_SAG_LMA_SDRAM = 0x00000000 ;
	SDRAM_BEGIN = NDS_SAG_LMA_SDRAM;
	. = 0x00000000;
	_ILM_BASE = 0x00600000;
	_DLM_BASE = 0x00700000;
	_ILM_SIZE = 0x00010000;
	_DLM_SIZE = 0x00010000;
	.nds32_init 	: { KEEP(*(.nds32_init )) }
	.option 	: { KEEP(*(.option )) }
	.interp 	: { *(EXCLUDE_FILE (*xip.o ).interp ) }
	.hash 	: { *(EXCLUDE_FILE (*xip.o ).hash ) }
	.dynsym 	: { *(EXCLUDE_FILE (*xip.o ).dynsym ) }
	.dynstr 	: { *(EXCLUDE_FILE (*xip.o ).dynstr ) }
	.gnu.version 	: { *(EXCLUDE_FILE (*xip.o ).gnu.version ) }
	.gnu.version_d 	: { *(EXCLUDE_FILE (*xip.o ).gnu.version_d ) }
	.gnu.version_r 	: { *(EXCLUDE_FILE (*xip.o ).gnu.version_r ) }
	.rel.init 	: { *(EXCLUDE_FILE (*xip.o ).rel.init ) }
	.rela.init 	: { *(EXCLUDE_FILE (*xip.o ).rela.init ) }
	.rel.text 	: { *(EXCLUDE_FILE (*xip.o ).rel.text EXCLUDE_FILE (*xip.o ).rel.text.* EXCLUDE_FILE (*xip.o ).rel.gnu.linkonce.t.* ) }
	.rela.text 	: { *(EXCLUDE_FILE (*xip.o ).rela.text EXCLUDE_FILE (*xip.o ).rela.text.* EXCLUDE_FILE (*xip.o ).rela.gnu.linkonce.t.* ) }
	.rel.fini 	: { *(EXCLUDE_FILE (*xip.o ).rel.fini ) }
	.rela.fini 	: { *(EXCLUDE_FILE (*xip.o ).rela.fini ) }
	.rel.rodata 	: { *(EXCLUDE_FILE (*xip.o ).rel.rodata EXCLUDE_FILE (*xip.o ).rel.rodata.* EXCLUDE_FILE (*xip.o ).rel.gnu.linkonce.r.* ) }
	.rela.rodata 	: { *(EXCLUDE_FILE (*xip.o ).rela.rodata EXCLUDE_FILE (*xip.o ).rela.rodata.* EXCLUDE_FILE (*xip.o ).rela.gnu.linkonce.r.* ) }
	.rel.data.rel.ro 	: { *(EXCLUDE_FILE (*xip.o ).rel.data.rel.ro* ) }
	.rela.data.rel.ro 	: { *(EXCLUDE_FILE (*xip.o ).rel.data.rel.ro* ) }
	.rel.data 	: { *(EXCLUDE_FILE (*xip.o ).rel.data EXCLUDE_FILE (*xip.o ).rel.data.* EXCLUDE_FILE (*xip.o ).rel.gnu.linkonce.d.* ) }
	.rela.data 	: { *(EXCLUDE_FILE (*xip.o ).rela.data EXCLUDE_FILE (*xip.o ).rela.data.* EXCLUDE_FILE (*xip.o ).rela.gnu.linkonce.d.* ) }
	.rel.tdata 	: { *(EXCLUDE_FILE (*xip.o ).rel.tdata EXCLUDE_FILE (*xip.o ).rel.tdata.* EXCLUDE_FILE (*xip.o ).rel.gnu.linkonce.td.* ) }
	.rela.tdata 	: { *(EXCLUDE_FILE (*xip.o ).rela.tdata EXCLUDE_FILE (*xip.o ).rela.tdata.* EXCLUDE_FILE (*xip.o ).rela.gnu.linkonce.td.* ) }
	.rel.tbss 	: { *(EXCLUDE_FILE (*xip.o ).rel.tbss EXCLUDE_FILE (*xip.o ).rel.tbss.* EXCLUDE_FILE (*xip.o ).rel.gnu.linkonce.tb.* ) }
	.rela.tbss 	: { *(EXCLUDE_FILE (*xip.o ).rela.tbss EXCLUDE_FILE (*xip.o ).rela.tbss.* EXCLUDE_FILE (*xip.o ).rela.gnu.linkonce.tb.* ) }
	.rel.ctors 	: { *(EXCLUDE_FILE (*xip.o ).rel.ctors ) }
	.rela.ctors 	: { *(EXCLUDE_FILE (*xip.o ).rela.ctors ) }
	.rel.dtors 	: { *(EXCLUDE_FILE (*xip.o ).rel.dtors ) }
	.rela.dtors 	: { *(EXCLUDE_FILE (*xip.o ).rela.dtors ) }
	.rela.dyn 	: { *(EXCLUDE_FILE (*xip.o )rela.dyn ) *(EXCLUDE_FILE (*xip.o ).rela__libc_subfreeres ) *(EXCLUDE_FILE (*xip.o ).rela__libc_atexit ) *(EXCLUDE_FILE (*xip.o ).rela__libc_thread_subfreeres ) *(EXCLUDE_FILE (*xip.o ).rela.init_array ) *(EXCLUDE_FILE (*xip.o ).rela.fini_array ) }
	.rel.got 	: { *(EXCLUDE_FILE (*xip.o ).rel.got ) }
	.rela.got 	: { *(EXCLUDE_FILE (*xip.o ).rela.got ) }
	.rel.sdata 	: { *(EXCLUDE_FILE (*xip.o ).rel.sdata EXCLUDE_FILE (*xip.o ).rel.sdata.* EXCLUDE_FILE (*xip.o ).rel.gnu.linkonce.s.* ) }
	.rela.sdata 	: { *(EXCLUDE_FILE (*xip.o ).rela.sdata EXCLUDE_FILE (*xip.o ).rela.sdata.* EXCLUDE_FILE (*xip.o ).rela.gnu.linkonce.s.* ) }
	.rel.sbss 	: { *(EXCLUDE_FILE (*xip.o ).rel.sbss EXCLUDE_FILE (*xip.o ).rel.sbss.* EXCLUDE_FILE (*xip.o ).rel.gnu.linkonce.sb.* ) }
	.rela.sbss 	: { *(EXCLUDE_FILE (*xip.o ).rela.sbss EXCLUDE_FILE (*xip.o ).rela.sbss.* EXCLUDE_FILE (*xip.o ).rela.gnu.linkonce.sb.* ) }
	.rel.sdata2 	: { *(EXCLUDE_FILE (*xip.o ).rel.sdata2 EXCLUDE_FILE (*xip.o ).rel.sdata2.* EXCLUDE_FILE (*xip.o ).rel.gnu.linkonce.s2.* ) }
	.rela.sdata2 	: { *(EXCLUDE_FILE (*xip.o ).rela.sdata2 EXCLUDE_FILE (*xip.o ).rela.sdata2.* EXCLUDE_FILE (*xip.o ).rela.gnu.linkonce.s2.* ) }
	.rel.sbss2 	: { *(EXCLUDE_FILE (*xip.o ).rel.sbss2 EXCLUDE_FILE (*xip.o ).rel.sbss2.* EXCLUDE_FILE (*xip.o ).rel.gnu.linkonce.sb2.* ) }
	.rela.sbss2 	: { *(EXCLUDE_FILE (*xip.o ).rela.sbss2 EXCLUDE_FILE (*xip.o ).rela.sbss2.* EXCLUDE_FILE (*xip.o ).rela.gnu.linkonce.sb2.* ) }
	.rel.bss 	: { *(EXCLUDE_FILE (*xip.o ).rel.bss EXCLUDE_FILE (*xip.o ).rel.bss.* EXCLUDE_FILE (*xip.o ).rel.gnu.linkonce.b.* ) }
	.rela.bss 	: { *(EXCLUDE_FILE (*xip.o ).rela.bss EXCLUDE_FILE (*xip.o ).rela.bss.* EXCLUDE_FILE (*xip.o ).rela.gnu.linkonce.b.* ) }
	.rel.plt 	: { *(EXCLUDE_FILE (*xip.o ).rel.plt ) }
	.rela.plt 	: { *(EXCLUDE_FILE (*xip.o ).rela.plt ) }
	.init 	: { KEEP(*(EXCLUDE_FILE (*xip.o ).init )) }
	.plt 	: { *(EXCLUDE_FILE (*xip.o ).plt ) }
	.text 	: { *(EXCLUDE_FILE (*xip.o ).text EXCLUDE_FILE (*xip.o ).stub EXCLUDE_FILE (*xip.o ).text.* EXCLUDE_FILE (*xip.o ).gnu.linkonce.t.* ) KEEP(*(EXCLUDE_FILE (*xip.o ).text.*personality* )) *(EXCLUDE_FILE (*xip.o ).gnu.warning ) . = ALIGN(4); }
	.fini 	: { KEEP(*(EXCLUDE_FILE (*xip.o ).fini )) }
	.ex9.itable 	: { *(EXCLUDE_FILE (*xip.o ).ex9.itable ) }
	PROVIDE (__etext = .);
	PROVIDE (_etext = .);
	PROVIDE (etext = .);
	.rodata 	: { *(EXCLUDE_FILE (*xip.o ).rodata EXCLUDE_FILE (*xip.o ).rodata.* EXCLUDE_FILE (*xip.o ).gnu.linkonce.r.* ) }
	.rodata1 	: { *(EXCLUDE_FILE (*xip.o ).rodata1 ) }
	.sdata2 	: { *(EXCLUDE_FILE (*xip.o ).sdata2 EXCLUDE_FILE (*xip.o ).sdata2.* EXCLUDE_FILE (*xip.o ).gnu.linkonce.s2.* ) }
	.sbss2 	: { *(EXCLUDE_FILE (*xip.o ).sbss2 EXCLUDE_FILE (*xip.o ).sbss2.* EXCLUDE_FILE (*xip.o ).gnu.linkonce.sb2.* ) }
	.eh_frame_hdr 	: { *(EXCLUDE_FILE (*xip.o ).eh_frame_hdr ) }
	. = 0x00400000;
	__data_start = .;
	. = ALIGN(0x20);
	__data_lmastart =  LOADADDR (.eh_frame);
	.eh_frame 	: AT(ALIGN(LOADADDR (.eh_frame_hdr) + SIZEOF (.eh_frame_hdr), 32))
		{ KEEP(*(.eh_frame )) }
	.gcc_except_table 	: AT(ALIGN(LOADADDR (.eh_frame) + SIZEOF (.eh_frame), ALIGNOF(.gcc_except_table)))
		{ KEEP(*(.gcc_except_table )) *(.gcc_except_table.* ) }
	.tdata 	: AT(ALIGN(LOADADDR (.gcc_except_table) + SIZEOF (.gcc_except_table), ALIGNOF(.tdata)))
		{ *(.tdata .tdata.* .gnu.linkonce.td.* ) }
	. = ALIGN(4);
	PROVIDE (__preinit_array_start = .);
	.preinit_array 	: AT(ALIGN(ALIGN(LOADADDR (.tdata) + SIZEOF (.tdata), ALIGNOF(.preinit_array)), 4))
		{ KEEP(*(.preinit_array )) }
	PROVIDE (__preinit_array_end = .);
	PROVIDE (__init_array_start = .);
	.init_array 	: AT(ALIGN(LOADADDR (.preinit_array) + SIZEOF (.preinit_array), ALIGNOF(.init_array)))
		{ KEEP(*(.init_array )) }
	PROVIDE (__init_array_end = .);
	PROVIDE (__fini_array_start = .);
	.fini_array 	: AT(ALIGN(LOADADDR (.init_array) + SIZEOF (.init_array), ALIGNOF(.fini_array)))
		{ KEEP(*(.fini_array )) }
	PROVIDE (__fini_array_end = .);
	.ctors 	: AT(ALIGN(LOADADDR (.fini_array) + SIZEOF (.fini_array), ALIGNOF(.ctors)))
		{ KEEP(*crtbegin*.o(.ctors)) KEEP(*(EXCLUDE_FILE (*crtend*.o) .ctors)) KEEP(*(SORT(.ctors.* ))) KEEP(*(.ctors )) }
	.dtors 	: AT(ALIGN(LOADADDR (.ctors) + SIZEOF (.ctors), ALIGNOF(.dtors)))
		{ KEEP(*crtbegin*.o(.dtors)) KEEP(*(EXCLUDE_FILE (*crtend*.o) .dtors)) KEEP(*(SORT(.dtors.* ))) KEEP(*(.dtors )) }
	.jcr 	: AT(ALIGN(LOADADDR (.dtors) + SIZEOF (.dtors), ALIGNOF(.jcr)))
		{ KEEP(*(.jcr )) }
	.data.rel.ro 	: AT(ALIGN(LOADADDR (.jcr) + SIZEOF (.jcr), ALIGNOF(.data.rel.ro)))
		{ *(.data.rel.ro.local ) *(.data.rel.ro* ) }
	.dynamic 	: AT(ALIGN(LOADADDR (.data.rel.ro) + SIZEOF (.data.rel.ro), ALIGNOF(.dynamic)))
		{ *(.dynamic ) }
	.data 	: AT(ALIGN(LOADADDR (.dynamic) + SIZEOF (.dynamic), ALIGNOF(.data)))
		{ *(.data .data.* .gnu.linkonce.d.* ) KEEP(*(.gnu.linkonce.d.*personality* )) SORT(CONSTRUCTORS) . = ALIGN(8); }
	.data1 	: AT(ALIGN(LOADADDR (.data) + SIZEOF (.data), ALIGNOF(.data1)))
		{ *(.data1 ) . = ALIGN(8); }
	. = ALIGN(4);
	.got 	: AT(ALIGN(ALIGN(LOADADDR (.data1) + SIZEOF (.data1), ALIGNOF(.got)), 4))
		{ *(.got.plt ) *(.got ) }
	.sdata_d 	: AT(ALIGN(LOADADDR (.got) + SIZEOF (.got), ALIGNOF(.sdata_d)))
		{ *(.sdata_d .sdata_d.* ) }
	.sdata_w 	: AT(ALIGN(LOADADDR (.sdata_d) + SIZEOF (.sdata_d), ALIGNOF(.sdata_w)))
		{ *(.sdata_w .sdata_w.* ) }
	.sdata_h 	: AT(ALIGN(LOADADDR (.sdata_w) + SIZEOF (.sdata_w), ALIGNOF(.sdata_h)))
		{ *(.sdata_h .sdata_h.* ) }
	.sdata_b 	: AT(ALIGN(LOADADDR (.sdata_h) + SIZEOF (.sdata_h), ALIGNOF(.sdata_b)))
		{ *(.sdata_b .sdata_b.* ) }
	.sdata_f 	: AT(ALIGN(LOADADDR (.sdata_b) + SIZEOF (.sdata_b), ALIGNOF(.sdata_f)))
		{ *(.sdata_f .sdata_f.* ) }
	. = ALIGN(4);
	_edata = .;
	PROVIDE (edata = .);
	__bss_start = .;
	PROVIDE (__sbss_start = .);
	PROVIDE (___sbss_start = .);
	.tbss 	: AT(ALIGN(ALIGN(LOADADDR (.sdata_f) + SIZEOF (.sdata_f), ALIGNOF(.tbss)), 4))
		{ *(.tbss .tbss.* .gnu.linkonce.tb.* ) *(.tcommon ) }
	.sbss_f 	: AT(ALIGN(LOADADDR (.tbss) + SIZEOF (.tbss), ALIGNOF(.sbss_f)))
		{ *(.sbss_f .sbss_f.* ) *(.scommon_f .scommon_f.* ) }
	.sbss_b 	: AT(ALIGN(LOADADDR (.sbss_f) + SIZEOF (.sbss_f), ALIGNOF(.sbss_b)))
		{ *(.sbss_b .sbss_b.* ) *(.scommon_b .scommon_b.* ) . = ALIGN(2); }
	.sbss_h 	: AT(ALIGN(LOADADDR (.sbss_b) + SIZEOF (.sbss_b), ALIGNOF(.sbss_h)))
		{ *(.sbss_h .sbss_h.* ) *(.scommon_h .scommon_h.* ) . = ALIGN(4); }
	.sbss_w 	: AT(ALIGN(LOADADDR (.sbss_h) + SIZEOF (.sbss_h), ALIGNOF(.sbss_w)))
		{ *(.sbss_w .sbss_w.* ) *(.scommon_w .scommon_w.* ) *(.dynsbss ) *(.scommon ) . = ALIGN(8); }
	.sbss_d 	: AT(ALIGN(LOADADDR (.sbss_w) + SIZEOF (.sbss_w), ALIGNOF(.sbss_d)))
		{ *(.sbss_d .sbss_d.* ) *(.scommon_d .scommon_d.* ) }
	.bss 	: AT(ALIGN(LOADADDR (.sbss_d) + SIZEOF (.sbss_d), ALIGNOF(.bss)))
		{ *(.dynbss ) *(.bss .bss.* .gnu.linkonce.b.* ) *(COMMON ) . = ALIGN(4); }
	PROVIDE (__sbss_end = .);
	PROVIDE (___sbss_end = .);
	. = ALIGN(4);
	_end = .;
	PROVIDE (end = .);
	.heap 	: AT(LOADADDR (.bss) + SIZEOF (.bss))
		{ KEEP(*(.heap )) }
	PROVIDE (_stack = 0x404000);
	SDRAM_SIZE = LOADADDR(.heap) + SIZEOF(.heap) - SDRAM_BEGIN;
	NDS_SAG_LMA_ROMXIP = 0x20000 ;
	. = 0x00800400;
	".nds32_init_*xip.o" .	: AT(ALIGN(NDS_SAG_LMA_ROMXIP, ALIGNOF(".nds32_init_*xip.o")))	{ KEEP(*xip.o(.nds32_init )) }
	".interp_*xip.o" 	: AT(ALIGN(LOADADDR (".nds32_init_*xip.o") + SIZEOF (".nds32_init_*xip.o"), ALIGNOF(".interp_*xip.o")))
		{ KEEP(*xip.o(.interp )) }
	".hash_*xip.o" 	: AT(ALIGN(LOADADDR (".interp_*xip.o") + SIZEOF (".interp_*xip.o"), ALIGNOF(".hash_*xip.o")))
		{ KEEP(*xip.o(.hash )) }
	".dynsym_*xip.o" 	: AT(ALIGN(LOADADDR (".hash_*xip.o") + SIZEOF (".hash_*xip.o"), ALIGNOF(".dynsym_*xip.o")))
		{ KEEP(*xip.o(.dynsym )) }
	".dynstr_*xip.o" 	: AT(ALIGN(LOADADDR (".dynsym_*xip.o") + SIZEOF (".dynsym_*xip.o"), ALIGNOF(".dynstr_*xip.o")))
		{ KEEP(*xip.o(.dynstr )) }
	".gnu.version_*xip.o" 	: AT(ALIGN(LOADADDR (".dynstr_*xip.o") + SIZEOF (".dynstr_*xip.o"), ALIGNOF(".gnu.version_*xip.o")))
		{ KEEP(*xip.o(.gnu.version )) }
	".gnu.version_d_*xip.o" 	: AT(ALIGN(LOADADDR (".gnu.version_*xip.o") + SIZEOF (".gnu.version_*xip.o"), ALIGNOF(".gnu.version_d_*xip.o")))
		{ KEEP(*xip.o(.gnu.version_d )) }
	".gnu.version_r_*xip.o" 	: AT(ALIGN(LOADADDR (".gnu.version_d_*xip.o") + SIZEOF (".gnu.version_d_*xip.o"), ALIGNOF(".gnu.version_r_*xip.o")))
		{ KEEP(*xip.o(.gnu.version_r )) }
	".rel.init_*xip.o" 	: AT(ALIGN(LOADADDR (".gnu.version_r_*xip.o") + SIZEOF (".gnu.version_r_*xip.o"), ALIGNOF(".rel.init_*xip.o")))
		{ KEEP(*xip.o(.rel.init )) }
	".rela.init_*xip.o" 	: AT(ALIGN(LOADADDR (".rel.init_*xip.o") + SIZEOF (".rel.init_*xip.o"), ALIGNOF(".rela.init_*xip.o")))
		{ KEEP(*xip.o(.rela.init )) }
	".rel.text_*xip.o" 	: AT(ALIGN(LOADADDR (".rela.init_*xip.o") + SIZEOF (".rela.init_*xip.o"), ALIGNOF(".rel.text_*xip.o")))
		{ KEEP(*xip.o(.rel.text .rel.text.* .rel.gnu.linkonce.t.* )) }
	".rela.text_*xip.o" 	: AT(ALIGN(LOADADDR (".rel.text_*xip.o") + SIZEOF (".rel.text_*xip.o"), ALIGNOF(".rela.text_*xip.o")))
		{ KEEP(*xip.o(.rela.text .rela.text.* .rela.gnu.linkonce.t.* )) }
	".rel.fini_*xip.o" 	: AT(ALIGN(LOADADDR (".rela.text_*xip.o") + SIZEOF (".rela.text_*xip.o"), ALIGNOF(".rel.fini_*xip.o")))
		{ KEEP(*xip.o(.rel.fini )) }
	".rela.fini_*xip.o" 	: AT(ALIGN(LOADADDR (".rel.fini_*xip.o") + SIZEOF (".rel.fini_*xip.o"), ALIGNOF(".rela.fini_*xip.o")))
		{ KEEP(*xip.o(.rela.fini )) }
	".rel.rodata_*xip.o" 	: AT(ALIGN(LOADADDR (".rela.fini_*xip.o") + SIZEOF (".rela.fini_*xip.o"), ALIGNOF(".rel.rodata_*xip.o")))
		{ KEEP(*xip.o(.rel.rodata .rel.rodata.* .rel.gnu.linkonce.r.* )) }
	".rela.rodata_*xip.o" 	: AT(ALIGN(LOADADDR (".rel.rodata_*xip.o") + SIZEOF (".rel.rodata_*xip.o"), ALIGNOF(".rela.rodata_*xip.o")))
		{ KEEP(*xip.o(.rela.rodata .rela.rodata.* .rela.gnu.linkonce.r.* )) }
	".rel.data.rel.ro_*xip.o" 	: AT(ALIGN(LOADADDR (".rela.rodata_*xip.o") + SIZEOF (".rela.rodata_*xip.o"), ALIGNOF(".rel.data.rel.ro_*xip.o")))
		{ KEEP(*xip.o(.rel.data.rel.ro* )) }
	".rela.data.rel.ro_*xip.o" 	: AT(ALIGN(LOADADDR (".rel.data.rel.ro_*xip.o") + SIZEOF (".rel.data.rel.ro_*xip.o"), ALIGNOF(".rela.data.rel.ro_*xip.o")))
		{ KEEP(*xip.o(.rel.data.rel.ro* )) }
	".rel.data_*xip.o" 	: AT(ALIGN(LOADADDR (".rela.data.rel.ro_*xip.o") + SIZEOF (".rela.data.rel.ro_*xip.o"), ALIGNOF(".rel.data_*xip.o")))
		{ KEEP(*xip.o(.rel.data .rel.data.* .rel.gnu.linkonce.d.* )) }
	".rela.data_*xip.o" 	: AT(ALIGN(LOADADDR (".rel.data_*xip.o") + SIZEOF (".rel.data_*xip.o"), ALIGNOF(".rela.data_*xip.o")))
		{ KEEP(*xip.o(.rela.data .rela.data.* .rela.gnu.linkonce.d.* )) }
	".rel.tdata_*xip.o" 	: AT(ALIGN(LOADADDR (".rela.data_*xip.o") + SIZEOF (".rela.data_*xip.o"), ALIGNOF(".rel.tdata_*xip.o")))
		{ KEEP(*xip.o(.rel.tdata .rel.tdata.* .rel.gnu.linkonce.td.* )) }
	".rela.tdata_*xip.o" 	: AT(ALIGN(LOADADDR (".rel.tdata_*xip.o") + SIZEOF (".rel.tdata_*xip.o"), ALIGNOF(".rela.tdata_*xip.o")))
		{ KEEP(*xip.o(.rela.tdata .rela.tdata.* .rela.gnu.linkonce.td.* )) }
	".rel.tbss_*xip.o" 	: AT(ALIGN(LOADADDR (".rela.tdata_*xip.o") + SIZEOF (".rela.tdata_*xip.o"), ALIGNOF(".rel.tbss_*xip.o")))
		{ KEEP(*xip.o(.rel.tbss .rel.tbss.* .rel.gnu.linkonce.tb.* )) }
	".rela.tbss_*xip.o" 	: AT(ALIGN(LOADADDR (".rel.tbss_*xip.o") + SIZEOF (".rel.tbss_*xip.o"), ALIGNOF(".rela.tbss_*xip.o")))
		{ KEEP(*xip.o(.rela.tbss .rela.tbss.* .rela.gnu.linkonce.tb.* )) }
	".rel.ctors_*xip.o" 	: AT(ALIGN(LOADADDR (".rela.tbss_*xip.o") + SIZEOF (".rela.tbss_*xip.o"), ALIGNOF(".rel.ctors_*xip.o")))
		{ KEEP(*xip.o(.rel.ctors )) }
	".rela.ctors_*xip.o" 	: AT(ALIGN(LOADADDR (".rel.ctors_*xip.o") + SIZEOF (".rel.ctors_*xip.o"), ALIGNOF(".rela.ctors_*xip.o")))
		{ KEEP(*xip.o(.rela.ctors )) }
	".rel.dtors_*xip.o" 	: AT(ALIGN(LOADADDR (".rela.ctors_*xip.o") + SIZEOF (".rela.ctors_*xip.o"), ALIGNOF(".rel.dtors_*xip.o")))
		{ KEEP(*xip.o(.rel.dtors )) }
	".rela.dtors_*xip.o" 	: AT(ALIGN(LOADADDR (".rel.dtors_*xip.o") + SIZEOF (".rel.dtors_*xip.o"), ALIGNOF(".rela.dtors_*xip.o")))
		{ KEEP(*xip.o(.rela.dtors )) }
	".rela.dyn_*xip.o" 	: AT(ALIGN(LOADADDR (".rela.dtors_*xip.o") + SIZEOF (".rela.dtors_*xip.o"), ALIGNOF(".rela.dyn_*xip.o")))
		{ KEEP(*xip.o(rela.dyn )) KEEP(*xip.o(.rela__libc_subfreeres )) KEEP(*xip.o(.rela__libc_atexit )) KEEP(*xip.o(.rela__libc_thread_subfreeres )) KEEP(*xip.o(.rela.init_array )) KEEP(*xip.o(.rela.fini_array )) }
	".rel.got_*xip.o" 	: AT(ALIGN(LOADADDR (".rela.dyn_*xip.o") + SIZEOF (".rela.dyn_*xip.o"), ALIGNOF(".rel.got_*xip.o")))
		{ KEEP(*xip.o(.rel.got )) }
	".rela.got_*xip.o" 	: AT(ALIGN(LOADADDR (".rel.got_*xip.o") + SIZEOF (".rel.got_*xip.o"), ALIGNOF(".rela.got_*xip.o")))
		{ KEEP(*xip.o(.rela.got )) }
	".rel.sdata_*xip.o" 	: AT(ALIGN(LOADADDR (".rela.got_*xip.o") + SIZEOF (".rela.got_*xip.o"), ALIGNOF(".rel.sdata_*xip.o")))
		{ KEEP(*xip.o(.rel.sdata .rel.sdata.* .rel.gnu.linkonce.s.* )) }
	".rela.sdata_*xip.o" 	: AT(ALIGN(LOADADDR (".rel.sdata_*xip.o") + SIZEOF (".rel.sdata_*xip.o"), ALIGNOF(".rela.sdata_*xip.o")))
		{ KEEP(*xip.o(.rela.sdata .rela.sdata.* .rela.gnu.linkonce.s.* )) }
	".rel.sbss_*xip.o" 	: AT(ALIGN(LOADADDR (".rela.sdata_*xip.o") + SIZEOF (".rela.sdata_*xip.o"), ALIGNOF(".rel.sbss_*xip.o")))
		{ KEEP(*xip.o(.rel.sbss .rel.sbss.* .rel.gnu.linkonce.sb.* )) }
	".rela.sbss_*xip.o" 	: AT(ALIGN(LOADADDR (".rel.sbss_*xip.o") + SIZEOF (".rel.sbss_*xip.o"), ALIGNOF(".rela.sbss_*xip.o")))
		{ KEEP(*xip.o(.rela.sbss .rela.sbss.* .rela.gnu.linkonce.sb.* )) }
	".rel.sdata2_*xip.o" 	: AT(ALIGN(LOADADDR (".rela.sbss_*xip.o") + SIZEOF (".rela.sbss_*xip.o"), ALIGNOF(".rel.sdata2_*xip.o")))
		{ KEEP(*xip.o(.rel.sdata2 .rel.sdata2.* .rel.gnu.linkonce.s2.* )) }
	".rela.sdata2_*xip.o" 	: AT(ALIGN(LOADADDR (".rel.sdata2_*xip.o") + SIZEOF (".rel.sdata2_*xip.o"), ALIGNOF(".rela.sdata2_*xip.o")))
		{ KEEP(*xip.o(.rela.sdata2 .rela.sdata2.* .rela.gnu.linkonce.s2.* )) }
	".rel.sbss2_*xip.o" 	: AT(ALIGN(LOADADDR (".rela.sdata2_*xip.o") + SIZEOF (".rela.sdata2_*xip.o"), ALIGNOF(".rel.sbss2_*xip.o")))
		{ KEEP(*xip.o(.rel.sbss2 .rel.sbss2.* .rel.gnu.linkonce.sb2.* )) }
	".rela.sbss2_*xip.o" 	: AT(ALIGN(LOADADDR (".rel.sbss2_*xip.o") + SIZEOF (".rel.sbss2_*xip.o"), ALIGNOF(".rela.sbss2_*xip.o")))
		{ KEEP(*xip.o(.rela.sbss2 .rela.sbss2.* .rela.gnu.linkonce.sb2.* )) }
	".rel.bss_*xip.o" 	: AT(ALIGN(LOADADDR (".rela.sbss2_*xip.o") + SIZEOF (".rela.sbss2_*xip.o"), ALIGNOF(".rel.bss_*xip.o")))
		{ KEEP(*xip.o(.rel.bss .rel.bss.* .rel.gnu.linkonce.b.* )) }
	".rela.bss_*xip.o" 	: AT(ALIGN(LOADADDR (".rel.bss_*xip.o") + SIZEOF (".rel.bss_*xip.o"), ALIGNOF(".rela.bss_*xip.o")))
		{ KEEP(*xip.o(.rela.bss .rela.bss.* .rela.gnu.linkonce.b.* )) }
	".rel.plt_*xip.o" 	: AT(ALIGN(LOADADDR (".rela.bss_*xip.o") + SIZEOF (".rela.bss_*xip.o"), ALIGNOF(".rel.plt_*xip.o")))
		{ KEEP(*xip.o(.rel.plt )) }
	".rela.plt_*xip.o" 	: AT(ALIGN(LOADADDR (".rel.plt_*xip.o") + SIZEOF (".rel.plt_*xip.o"), ALIGNOF(".rela.plt_*xip.o")))
		{ KEEP(*xip.o(.rela.plt )) }
	".init_*xip.o" 	: AT(ALIGN(LOADADDR (".rela.plt_*xip.o") + SIZEOF (".rela.plt_*xip.o"), ALIGNOF(".init_*xip.o")))
		{ KEEP(*xip.o(.init )) }
	".plt_*xip.o" 	: AT(ALIGN(LOADADDR (".init_*xip.o") + SIZEOF (".init_*xip.o"), ALIGNOF(".plt_*xip.o")))
		{ KEEP(*xip.o(.plt )) }
	".text_*xip.o" 	: AT(ALIGN(LOADADDR (".plt_*xip.o") + SIZEOF (".plt_*xip.o"), ALIGNOF(".text_*xip.o")))
		{ KEEP(*xip.o(.text .stub .text.* .gnu.linkonce.t.* )) KEEP(*xip.o(.text.*personality* )) KEEP(*xip.o(.gnu.warning )) . = ALIGN(4); }
	".fini_*xip.o" 	: AT(ALIGN(LOADADDR (".text_*xip.o") + SIZEOF (".text_*xip.o"), ALIGNOF(".fini_*xip.o")))
		{ KEEP(*xip.o(.fini )) }
	".ex9.itable_*xip.o" 	: AT(ALIGN(LOADADDR (".fini_*xip.o") + SIZEOF (".fini_*xip.o"), ALIGNOF(".ex9.itable_*xip.o")))
		{ KEEP(*xip.o(.ex9.itable )) }
	PROVIDE (__etext = .);
	PROVIDE (_etext = .);
	PROVIDE (etext = .);
	".rodata_*xip.o" 	: AT(ALIGN(LOADADDR (".ex9.itable_*xip.o") + SIZEOF (".ex9.itable_*xip.o"), ALIGNOF(".rodata_*xip.o")))
		{ KEEP(*xip.o(.rodata .rodata.* .gnu.linkonce.r.* )) }
	".rodata1_*xip.o" 	: AT(ALIGN(LOADADDR (".rodata_*xip.o") + SIZEOF (".rodata_*xip.o"), ALIGNOF(".rodata1_*xip.o")))
		{ KEEP(*xip.o(.rodata1 )) }
	".sdata2_*xip.o" 	: AT(ALIGN(LOADADDR (".rodata1_*xip.o") + SIZEOF (".rodata1_*xip.o"), ALIGNOF(".sdata2_*xip.o")))
		{ KEEP(*xip.o(.sdata2 .sdata2.* .gnu.linkonce.s2.* )) }
	".sbss2_*xip.o" 	: AT(ALIGN(LOADADDR (".sdata2_*xip.o") + SIZEOF (".sdata2_*xip.o"), ALIGNOF(".sbss2_*xip.o")))
		{ KEEP(*xip.o(.sbss2 .sbss2.* .gnu.linkonce.sb2.* )) }
	".eh_frame_hdr_*xip.o" 	: AT(ALIGN(LOADADDR (".sbss2_*xip.o") + SIZEOF (".sbss2_*xip.o"), ALIGNOF(".eh_frame_hdr_*xip.o")))
		{ KEEP(*xip.o(.eh_frame_hdr )) }
	.stab	0 : { *(.stab) }
	.stabstr	0 : { *(.stabstr) }
	.stab.excl	0 : { *(.stab.excl) }
	.stab.exclstr	0 : { *(.stab.exclstr) }
	.stab.index	0 : { *(.stab.index) }
	.stab.indexstr	0 : { *(.stab.indexstr) }
	.note.nds32	0 : { *(.note.nds32) *(.note.nds32.*) }
	.comment	0 : { *(.comment) }
	.debug	0 : { *(.debug) }
	.line	0 : { *(.line) }
	.debug_srcinfo	0 : { *(.debug_srcinfo) }
	.debug_sfnames	0 : { *(.debug_sfnames) }
	.debug_aranges	0 : { *(.debug_aranges) }
	.debug_pubnames	0 : { *(.debug_pubnames) }
	.debug_info	0 : { *(.debug_info .gnu.linkonce.wi.*) }
	.debug_abbrev	0 : { *(.debug_abbrev) }
	.debug_line	0 : { *(.debug_line) }
	.debug_frame	0 : { *(.debug_frame) }
	.debug_str	0 : { *(.debug_str) }
	.debug_loc	0 : { *(.debug_loc) }
	.debug_macinfo	0 : { *(.debug_macinfo) }
	.debug_weaknames	0 : { *(.debug_weaknames) }
	.debug_funcnames	0 : { *(.debug_funcnames) }
	.debug_typenames	0 : { *(.debug_typenames) }
	.debug_varnames	0 : { *(.debug_varnames) }
}
ASSERT((DEFINED (_RELAX_END_) ? SDRAM_SIZE : 0x0) <= 0x200000, OVERFLOW);
